/* 
 * File Generated by GEOS buildExec 
 * Copyright (c) 2023 DefinitelyNotAGirl@github 
 */
OUTPUT_FORMAT("elf64-x86-64")
ENTRY(init)
SECTIONS {
	. = 0x0000000000000000;
	text : {
		build/gfs0.fs/*.o (.text*)
	}
	. = 0x0000000000000000;
	data : {
		build/gfs0.fs/*.o (.data*)
	}
	. = 0x0000000000000000;
	rodata : {
		build/gfs0.fs/*.o (.rodata*)
	}
	. = 0x0000000000000000;
	bss : {
		build/gfs0.fs/*.o (.bss*)
	}
	/DISCARD/ : {
		*(.note*)
		*(.iplt*)
		*(.igot*)
		*(.rel*)
		*(.comment*)
		*(.eh_frame*)
	}
}
