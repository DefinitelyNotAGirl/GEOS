/* 
 * File Generated by GEOS buildExec 
 * Copyright (c) 2023 DefinitelyNotAGirl@github 
 */
OUTPUT_FORMAT("binary")
ENTRY(init)
SECTIONS {
	. = 0x0000000000000000;
	text : {
		build/MALLOC/*.o (.text)
	}
	. = 0x0000000000000000;
	data : {
		build/MALLOC/*.o (.data)
	}
	. = 0x0000000000000000;
	rodata : {
		build/MALLOC/*.o (.rodata)
	}
	. = 0x0000000000000000;
	bss : {
		build/MALLOC/*.o (.bss)
	}
	/DISCARD/ : {
		*(.note*)
		*(.iplt*)
		*(.igot*)
		*(.rel*)
		*(.comment*)
		*(.eh_frame*)
	}
}
