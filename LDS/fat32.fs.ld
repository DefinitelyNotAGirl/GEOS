/* 
 * File Generated by GEOS buildExec 
 * Copyright (c) 2023 DefinitelyNotAGirl@github 
 */
OUTPUT_FORMAT("elf64-x86-64")
ENTRY(init)
SECTIONS {
	. = 0x0000000000000000;
	text : {
		build/fat32.fs/*.o (.text)
	}
	. = 0x0000000000000000;
	data : {
		build/fat32.fs/*.o (.data)
	}
	. = 0x0000000000000000;
	rodata : {
		build/fat32.fs/*.o (.rodata)
	}
	. = 0x0000000000000000;
	bss : {
		build/fat32.fs/*.o (.bss)
	}
	/DISCARD/ : {
		*(.note*)
		*(.iplt*)
		*(.igot*)
		*(.rel*)
		*(.comment*)
		*(.eh_frame*)
	}
}
